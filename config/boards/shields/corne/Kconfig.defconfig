## config/boards/shields/corne/Kconfig.defconfig
```kconfig
if SHIELD_SPLIT3X5_LEFT || SHIELD_SPLIT3X5_RIGHT

config ZMK_KEYBOARD_NAME
    default "Corne"

config ZMK_SPLIT
    default y

# Total matrix size: 4 rows x 5 columns
config ZMK_MATRIX_LAYOUT_ROWS
    default 4

config ZMK_MATRIX_LAYOUT_COLS
    default 5

endif
```

## config/boards/shields/corne/Kconfig.shield
```kconfig
config SHIELD_SPLIT3X5_LEFT
    def_bool $(shields_list_contains,split3x5_left)

config SHIELD_SPLIT3X5_RIGHT
    def_bool $(shields_list_contains,split3x5_right)
```

#include "corne.dtsi"

&kscan0 {
    row-gpios
        = <&gpio0 2 (GPIO_ACTIVE_HIGH | GPIO_PULL_DOWN)> // Row 1
        , <&gpio1 6  (GPIO_ACTIVE_HIGH | GPIO_PULL_DOWN)> // Row 2
        , <&gpio0 7 (GPIO_ACTIVE_HIGH | GPIO_PULL_DOWN)> // Row 3
        , <&gpio1 8  (GPIO_ACTIVE_HIGH | GPIO_PULL_DOWN)> // Row 4 (Thumb)
        ;

    col-gpios
        = <&gpio0 1  GPIO_ACTIVE_HIGH> // Col 1
        , <&gpio0 0  GPIO_ACTIVE_HIGH> // Col 2
        , <&gpio0 5 GPIO_ACTIVE_HIGH> // Col 3
        , <&gpio0 4 GPIO_ACTIVE_HIGH> // Col 4
        , <&gpio0 3 GPIO_ACTIVE_HIGH> // Col 5
        ;
};
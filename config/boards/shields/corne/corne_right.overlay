#include "corne.dtsi"

&default_transform {
    col-offset = <5>;
};

&kscan0 {
    row-gpios
        = <&gpio0 0  (GPIO_ACTIVE_HIGH | GPIO_PULL_DOWN)> // Row 1
        , <&gpio1 14 (GPIO_ACTIVE_HIGH | GPIO_PULL_DOWN)> // Row 2
        , <&gpio0 16 (GPIO_ACTIVE_HIGH | GPIO_PULL_DOWN)> // Row 3
        , <&gpio1 8  (GPIO_ACTIVE_HIGH | GPIO_PULL_DOWN)> // Row 4 (Thumb)
        ;

    col-gpios
        = <&gpio0 1  GPIO_ACTIVE_HIGH> // Col 1
        , <&gpio0 15 GPIO_ACTIVE_HIGH> // Col 2
        , <&gpio1 18 GPIO_ACTIVE_HIGH> // Col 3
        , <&gpio1 19 GPIO_ACTIVE_HIGH> // Col 4
        , <&gpio0 20  GPIO_ACTIVE_HIGH> // Col 5
        ;
};